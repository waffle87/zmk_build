## lulu/Kconfig.defconfig
```kconfig
# Copyright 2022 jack (@waffle87)
# SPDX-License-Identifier: MIT

if SHIELD_LULU_LEFT
config ZMK_KEYBOARD_NAME
  default "lulu"

config ZMK_SPLIT_ROLE_CENTRAL
  default y
endif

if SHIELD_LULU_LEFT || SHIELD_LULU_RIGHT
config ZMK_SPLIT
  default y
endif
```

## lulu/Kconfig.shield
```kconfig
# Copyright 2022 jack (@waffle87)
# SPDX-License-Identifier: MIT

config SHIELD_LULU_LEFT
  def_bool $(shields_list_contains,lulu_left)

config SHIELD_LULU_RIGHT
  def_bool $(shields_list_contains,lulu_right)
```

## revxlp/Kconfig.defconfig
```kconfig
# Copyright (c) 2022 The ZMK Contributors
# SPDX-License-Identifier: MIT

if SHIELD_REVXLP
config ZMK_KEYBOARD_NAME
  default "revxlp"
if ZMK_BACKLIGHT
config LED_GPIO
  default y
endif # ZMK_BACKLIGHT
endif
```

## revxlp/Kconfig.shield
```kconfig
# Copyright (c) 2024 The ZMK Contributors
# SPDX-License-Identifier: MIT

config SHIELD_REVXLP
  def_bool $(shields_list_contains,revxlp)
  select SPI
```

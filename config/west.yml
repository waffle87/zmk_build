## config/west.yml
```yaml
manifest:
  remotes:
    - name: zmkfirmware
      url-base: https://github.com/zmkfirmware
    - name: boardsource
      url-base: https://github.com/boardsource
    - name: urob
      url-base: https://github.com/urob
  projects:
    - name: zmk
      remote: zmkfirmware
      revision: main
      import: app/west.yml
    - name: wireless-corne_zmk_config
      remote: boardsource
      revision: master
    - name: zmk-helpers
      remote: urob
      revision: main
    - name: zmk-unicode
      remote: urob
      revision: main
  self:
    path: config
```

## flake/boards/shields/flake/Kconfig.defconfig
```kconfig
if SHIELD_FLAKE_LEFT || SHIELD_FLAKE_RIGHT
  config ZMK_SLEEP
    default y
  config ZMK_SPLIT
    default y
  config ZMK_SPLIT_ROLE_CENTRAL
    default n
endif
```

## flake/boards/shields/flake/Kconfig.shield
```kconfig
config SHIELD_FLAKE_LEFT
  def_bool $(shields_list_contains,flake_left)

config SHIELD_FLAKE_RIGHT
  def_bool $(shields_list_contains,flake_right)
```

## flake_dongle/boards/shields/flake_dongle/Kconfig.defconfig
```kconfig
if SHIELD_FLAKE_DONGLE
  config ZMK_KEYBOARD_NAME
    default "Flake Dongle"
  config ZMK_SPLIT_ROLE_CENTRAL
    default y
  config ZMK_SPLIT
    default y
  config ZMK_SPLIT_BLE_CENTRAL_PERIPHERALS
    default 2
endif
```

## revxlp/boards/shields/revxlp/Kconfig.defconfig
```kconfig
if SHIELD_REVXLP
  config ZMK_KEYBOARD_NAME
    default "revxlp"
  config ZMK_SLEEP
    default y
endif
```

## sweepable/boards/sweepable/Kconfig.defconfig
```kconfig
# Copyright (c) 2026 jack@pngu.org
# SPDX-License-Identifier: MIT

if BOARD_SWEEPABLE_LEFT

config ZMK_KEYBOARD_NAME
    default "Sweepable"

config ZMK_SPLIT_ROLE_CENTRAL
    default y

endif # BOARD_SWEEPABLE_LEFT

if BOARD_SWEEPABLE_LEFT || BOARD_SWEEPABLE_RIGHT

config BOARD
    default "sweepable"

config ZMK_SPLIT
    default y

config BT_CTLR
    default BT

if USB

config USB_NRFX
    default y

config USB_DEVICE_STACK
    default y

endif # USB

endif # BOARD_SWEEPABLE_LEFT || BOARD_SWEEPABLE_RIGHT
```

## sweepable/boards/sweepable/Kconfig.sweepable_right
```kconfig
# Copyright (c) 2026 jack@pngu.org
# SPDX-License-Identifier: MIT

config BOARD_SWEEPABLE_RIGHT
    select SOC_NRF52840_QIAA
    select ZMK_BOARD_COMPAT
```

## sweepable/boards/sweepable/board.yml
```yaml
boards:
  - name: sweepable_left
    vendor: pngu.org
    socs:
      - name: nrf52840
    revision:
      format: major.minor.patch
      default: 1.0.0
      exact: false
      revisions:
        - name: 1.0.0
  - name: sweepable_right
    vendor: pngu.org
    socs:
      - name: nrf52840
    revision:
      format: major.minor.patch
      default: 1.0.0
      exact: false
      revisions:
        - name: 1.0.0
```

## sweepable/boards/sweepable/sweepable_right_defconfig
```kconfig
# Copyright (c) 2026 jack@pngu.org
# SPDX-License-Identifier: MIT

# Enable MPU
CONFIG_ARM_MPU=y

# Enable pinctrl
CONFIG_PINCTRL=y

# Enable GPIO
CONFIG_GPIO=y

# Enable I2C
CONFIG_I2C=y

# Enable battery gauge driver
CONFIG_ZMK_MAX17048=y

# Enable writing to flash
CONFIG_USE_DT_CODE_PARTITION=y
CONFIG_BUILD_OUTPUT_UF2=y
CONFIG_MPU_ALLOW_FLASH_WRITE=y
CONFIG_NVS=y
CONFIG_SETTINGS_NVS=y
CONFIG_FLASH=y
CONFIG_FLASH_PAGE_LAYOUT=y
CONFIG_FLASH_MAP=y

# Enable 32kHz crystal
CONFIG_CLOCK_CONTROL_NRF_K32SRC_XTAL=y
CONFIG_CLOCK_CONTROL_NRF_K32SRC_30PPM=y

# Do not enable USB on right half
CONFIG_ZMK_USB=n

CONFIG_ZMK_BLE=y
CONFIG_ZMK_SLEEP=y
```

## sweeq/boards/shields/sweeq/Kconfig.defconfig
```kconfig
if SHIELD_SWEEQ_LEFT
  config ZMK_KEYBOARD_NAME
    default "Sweeq"
  config ZMK_SPLIT_ROLE_CENTRAL
    default y
endif

if SHIELD_SWEEQ_LEFT || SHIELD_SWEEQ_RIGHT
  config ZMK_SPLIT
    default y
endif
```

## sweeq/boards/shields/sweeq/Kconfig.shield
```kconfig
config SHIELD_SWEEQ_LEFT
  def_bool $(shields_list_contains,sweeq_left)

config SHIELD_SWEEQ_RIGHT
  def_bool $(shields_list_contains,sweeq_right)
```

// Copyright (c) 2026 jack@pngu.org
// SPDX-License-Identifier: MIT

#include "sweepable.dtsi"

/{
    kscan0: kscan {
        compatible = "zmk,kscan-gpio-matrix";
        wakeup-source;

        diode-direction = "col2row";
        row-gpios
            = <&gpio0 29 (GPIO_ACTIVE_HIGH | GPIO_PULL_DOWN)>
            , <&gpio0 30 (GPIO_ACTIVE_HIGH | GPIO_PULL_DOWN)>
            , <&gpio0 31 (GPIO_ACTIVE_HIGH | GPIO_PULL_DOWN)>
            , <&gpio0 4 (GPIO_ACTIVE_HIGH | GPIO_PULL_DOWN)>
            ;

        col-gpios
            = <&gpio0 28 GPIO_ACTIVE_HIGH>
            , <&gpio0 2 GPIO_ACTIVE_HIGH>
            , <&gpio0 3 GPIO_ACTIVE_HIGH>
            , <&gpio1 15 GPIO_ACTIVE_HIGH>
            , <&gpio1 13 GPIO_ACTIVE_HIGH>
            ;
    };
};
